/**************************************************************************/
/*
    @author   Ha Tran
    Hanoi Southern Observatory
    Software License Agreement (BSD License)
    All rights reserved.
*/
/**************************************************************************/

#define WiFi_Logo_width 60
#define WiFi_Logo_height 36

DynamicJsonDocument doc(1024);

const uint8_t activeSymbole[] PROGMEM = {
  B00000000,
  B00000000,
  B00011000,
  B00100100,
  B01000010,
  B01000010,
  B00100100,
  B00011000
};

const uint8_t inactiveSymbole[] PROGMEM = {
  B00000000,
  B00000000,
  B00000000,
  B00000000,
  B00011000,
  B00011000,
  B00000000,
  B00000000
};

// follow this article: https://en.wikipedia.org/wiki/Bortle_scale
String sqmToBortleScale(float sqm) {
  if (sqm >= 21.76) return "Bortle 1";
  if (sqm >= 21.6 && sqm < 21.76) return "Bortle 2";
  if (sqm >= 21.3 && sqm < 21.6) return "Bortle 3";
  if (sqm >= 20.8 && sqm < 21.3) return "Bortle 4";
  if (sqm >= 20.3 && sqm < 20.8) return "Bortle 4.5";
  if (sqm >= 19.25 && sqm < 20.3) return "Bortle 5";
  if (sqm >= 18.5 && sqm < 19.25) return "Bortle 6";
  if (sqm >= 18.0 && sqm < 18.5) return "Bortle 7";
  if (sqm >= 14.0 && sqm < 18.0) return "Bortle 8+";
  if (sqm < 14.0 && sqm > 0) return "Too bright";
  if (sqm <= 0) return "Missing Data";
}

void drawProgress(OLEDDisplay *display, int percentage, String label) {
  display->clear();
  display->setTextAlignment(TEXT_ALIGN_CENTER);
  display->setFont(ArialMT_Plain_10);
  display->drawString(64, 10, label);
  display->drawProgressBar(2, 28, 124, 10, percentage);
  display->display();
}

void drawMainContent(OLEDDisplay *display, OLEDDisplayUiState *state, int16_t x, int16_t y) {
  display->setFont(ArialMT_Plain_16);
  display->setTextAlignment(TEXT_ALIGN_CENTER);
  float sqm = doc["sqm"];
  display->drawString(64 + x, 5 + y, sqmToBortleScale(sqm));
  display->setTextAlignment(TEXT_ALIGN_CENTER);
  display->setFont(ArialMT_Plain_10);
  if (sqm > 0) {
    String ssqm = "Approx. SQM: " + String(sqm, 1);
    display->drawString(64 + x, 30 + y, ssqm);
  } else {
    display->drawString(64 + x, 30 + y, "Please connect sensor!");
  }
}

void drawHeaderOverlay(OLEDDisplay *display, OLEDDisplayUiState *state) {
  display->setFont(ArialMT_Plain_10);
  display->setTextAlignment(TEXT_ALIGN_LEFT);
  display->drawString(0, 54, doc["left_overlay"]);
  display->setTextAlignment(TEXT_ALIGN_RIGHT);
  display->drawString(128, 54, doc["right_overlay"]);
  display->drawHorizontalLine(0, 52, 128);
}

// you can use this icon for advanced functions later
const uint8_t WiFi_Logo_bits[] PROGMEM = {
  0x00,
  0x00,
  0x00,
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  0x00,
};
